// ------------------------------------------------------------------
// Persistence of Vision Ray Tracer Include File
// Emissive Spectral Data library for PoV-Ray
// ------------------------------------------------------------------
// Mixed sources originally compiled by Jaime Vives Piqueres for the
// lightsys macros, converted to splines by Ive.
//
// Added Mitsubishi spectra sampled by Ive
// 
// ------------------------------------------------------------------
/*
  Content:
  -------
  
  ES_GE_SW_Incandescent_60w  - GE Soft White incandescent 60 watt
  ES_GE_SW_Incandescent_100w - GE Soft White incandescent 100 watt
  ES_Nikon_SB16_XenonFlash   - Nikon SB-16 xenon flash
  ES_GTE_341_Warm            - warm white fluorescent tube
  ES_GTE_341_Cool            - cool white fluorescent tube

  ES_Phillips_PLS_11w        - Phillips PL-S compact white fluorescent 11 watt
  ES_Phillips_Mastercolor_3K - Phillips Mastercolor
  ES_Phillips_HPS            - Phillips High Pressure Sodium

  ES_Osram_CoolBeam_20w      - Osram Halogen 20 watt
  ES_Osram_CoolFluor_36w     - Osram Fluor 36 watt

  ES_Solux_Halog4700K        - Solux Halogen 47 VOR
  ES_Cornell_Box_Light       - Cornell box light (tungsten flood light with UV filter and diffusing glass plate)
  ES_Sunlight                - Sunlight (terrestrial - filtered by the atmosphere)
  ES_Extraterrestrial_Sun    - Sunlight (outer space - non filtered)
  ES_Daylight_Fluor          - Daylight fluorescent

  ES_Tungsten_Incandescent3K - Tungsten 3000k

  ES_Mitsubishi_Metal_Halide         -  ca. 4274K
  ES_Mitsubishi_Daylight_Fluorescent -  ca. 6245K
  ES_Mitsubishi_Moon_Fluorescent     -  ca. 4939K
  ES_Mitsubishi_Standard_Fluorescent -  ca. 4091K


*/

// Standard include file beginning stuff
#ifndef (espd_lightsys_Inc_Temp)
#declare espd_lightsys_Inc_Temp = version;

#ifdef(View_POV_Include_Stack)
  #debug "Including espd_lightsys.inc\n"
#end

//=============================================================

// Other light SPDs from graphics at the Cornell Univ:
// - GE Soft White incandescent -
#declare ES_GE_SW_Incandescent_60w = spline{ linear_spline
 350, 0
 400, 0.02
 450, 0.09
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 800, 0.85
}
#declare ES_GE_SW_Incandescent_100w = spline{ linear_spline
 350, 0
 400, 0.05
 450, 0.13
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 800, 1.3
}
// - Nikon SB-16 xenon flash -
#declare ES_Nikon_SB16_XenonFlash = spline{ linear_spline
 380, 0.04
 390, 0.05
 400, 0.04
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 800, 0
}
// GTE Fluorescents:
// - warm white fluorescent tube -
#declare ES_GTE_341_Warm = spline{ linear_spline
 380, 0.2
 390, 0.3
 400, 2.7
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 800, 0.0
}
// - cool white fluorescent tube -
#declare ES_GTE_341_Cool = spline{ linear_spline
 380, 0.5
 390, 0.7
 400, 3.8
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 800, 0.0
}
// Several Phillips bulbs and tubes, extrated from data sheets at phillips.com:
// - compact white fluorescent Phillips PL-S 11W -
#declare ES_Phillips_PLS_11w = spline{ linear_spline
 350, 0.0
 400, 0.001
 406, 0.600
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 800, 0.0
}
// - Mastercolor 3K -
#declare ES_Phillips_Mastercolor_3K = spline{ linear_spline
 350, 0.0
 400, 0.080
 405, 0.160
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 800, 0.0
}

// High Pressure Sodium
#declare ES_Phillips_HPS = spline{ linear_spline
 350, 0.0  
 400, 0.005,
 405, 0.0075
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 800, 0.0
}
// Osram lamps:
// - Tungsten Halogen -
#declare ES_Osram_CoolBeam_20w = spline{ linear_spline
 375, 0.05
 400, 0.10
 425, 0.20
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 775, 1.75
}
// - Cool_White Fluorescent -
#declare ES_Osram_CoolFluor_36w = spline{ linear_spline
 300, 0.0
 406, 0.23
 425, 0.08
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 800, 0.0
}
// Solux lamps:
// - Halogen 47 VOR -
#declare ES_Solux_Halog4700K = spline{ linear_spline
 380, 0.900
 400, 1.350
 420, 1.700
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 760, 2.600
}
// - cornell box light (tungsten flood light with UV filter and diffusing glass plate) -
#declare ES_Cornell_Box_Light = spline{ linear_spline
 375, 0.40
 400, 0.35
 425, 0.50
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 775, 2.50
}
// Pedro J. Aphalo:
// - sunlight -
#declare ES_Sunlight = spline{ linear_spline
 375, 1.2
 387, 1.5
 400, 2.0
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 762, 3.6
}       

#declare ES_Extraterrestrial_Sun = spline{ linear_spline
 375.0, 1.400
 380.5, 1.289
 385.5, 1.000
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 761.0, 1.238
} 

// - Daylight Fluorescent -
#declare ES_Daylight_Fluor = spline{ linear_spline
 380, 0.15
 390, 0.24
 400, 0.29
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 760, 0.01
}

// Mitsubishi fluorescent lamps 
#declare ES_Mitsubishi_Metal_Halide = spline {linear_spline
 380, 0.05537
 385, 0.06442
 390, 0.06739
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 720, 0.13659
}

#declare ES_Mitsubishi_Daylight_Fluorescent = spline {linear_spline
 380, 0.03800
 385, 0.04914
 390, 0.06142
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 720, 0.01911
}

#declare ES_Mitsubishi_Moon_Fluorescent = spline {linear_spline
 380, 0.02951
 385, 0.03851
 390, 0.04821
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 720, 0.01952
}

#declare ES_Mitsubishi_Standard_Fluorescent = spline {linear_spline
 380, 0.02713
 385, 0.03494
 390, 0.04322
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 720, 0.01644
}

#declare ES_Tungsten_Incandescent3K = spline {linear_spline
 360, 0.10804
 404, 0.16814
 410, 0.17633
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 830, 0.75000
}


//=============================================================

#macro espd_lightsys_Release()
  #undef ES_GE_SW_Incandescent_60w
  #undef ES_GE_SW_Incandescent_100w
  #undef ES_Nikon_SB16_XenonFlash
  #undef ES_GTE_341_Warm
  #undef ES_GTE_341_Cool
  #undef ES_Phillips_PLS_11w
  #undef ES_Phillips_Mastercolor_3K
  #undef ES_Phillips_HPS
  #undef ES_Osram_CoolBeam_20w
  #undef ES_Osram_CoolFluor_36w
  #undef ES_Solux_Halog4700K
  #undef ES_Cornell_Box_Light
  #undef ES_Sunlight
  #undef ES_Extraterrestrial_Sun
  #undef ES_Daylight_Fluor
  #undef ES_Mitsubishi_Metal_Halide
  #undef ES_Mitsubishi_Daylight_Fluorescent
  #undef ES_Mitsubishi_Moon_Fluorescent
  #undef ES_Mitsubishi_Standard_Fluorescent
  #undef espd_lightsys_Inc_Temp
#end  

//=============================================================
       
#version espd_lightsys_Inc_Temp;
#end // eof
