//================================================================================
// POV-Ray spectral render materials V0.21
//
// format for all specular definitions: 
// 36 columns for the wavelebgths of 380nm to 730nm in 10nm steps
//
// Ive, April 2014
//
//================================================================================

#ifndef (spectral_materials_inc) #declare spectral_materials_inc = 1;

//================================================================================
// parametric IOR / water, glasses and minerals
//
//================================================================================

// water 20°C
// IOR (550nm) = 1.33468  input W^2
#declare ParamIOR_Water = function(x) {
  sqrt( 1 + 5.684027565e-1*x/(x-5.101829712e-3) + 1.726177391e-1*x/(x-1.821153936e-2) + 2.086189578e-2*x/(x-2.620722293e-2) + 1.130748688e-1*x/(x-1.069792721e1) )
}

/*
// diamond 
// IOR (550nm) = 2.42295  input: W^2
#declare ParamIOR_Diamond = function(x) {
  sqrt( 1 + 4.3356*x/(x-pow(0.1060,2)) + 0.3306*x/(x-pow(0.1750,2)) )
} 
*/


#declare WavelengthFromIndex = function(x) { 380 + x*10 }  


#macro SpectralNormalize(A)
  #local MAX = 0;
  #for (I, 0, 35)    
     #if (A[I] > MAX) #local MAX = A[I]; #end
  #end
  #for (I, 0, 35)    
    #declare A[I] = A[I] / MAX;
  #end
#end
 

//================================================================================

#if (SpectralMode) 

//================================================================================
// SPECTRAL MODE
//================================================================================

//================================================================================
// Diffuse reflectance for the 24 patches of the "classic" GretagMacbeth
// ColorChecker chart.  
// And to be safe: ColorChecker is a Registered Trademark of X-Rite
// and X-Rite is a Trademark and I'm not related with one or the other in any way. 
// But here we go:  1-4 rows  A-F columns
//
//================================================================================

// wavelength nm              380      390      400      410      420      430      440      450      460      470      480      490      500      510      520      530      540      550      560      570      580      590      600      610      620      630      640      650      660      670      680      690      700      710      720      730

#declare D_CC_A1 = array[36] {0.05475, 0.05833, 0.06116, 0.06238, 0.06231, 0.06207, 0.06183, 0.06159, 0.06154, 0.06162, 0.06203, 0.06296, 0.06518,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 0.19605, 0.20949}
#declare D_CC_A2 = array[36] {0.05381, 0.05369, 0.05326, 0.05370, 0.05402, 0.05452, 0.05495, 0.05516, 0.05568, 0.05664, 0.05840, 0.06122, 0.06822,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 0.66255, 0.66681}
#declare D_CC_A3 = array[36] {0.06624, 0.07864, 0.10159, 0.14554, 0.19951, 0.24440, 0.28250, 0.30936, 0.30759, 0.27781, 0.23087, 0.17754, 0.12971,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 0.05731, 0.06498}
#declare D_CC_A4 = array[36] {0.18936, 0.25464, 0.42260, 0.66021, 0.81098, 0.86212, 0.87658, 0.88417, 0.89104, 0.89566, 0.89932, 0.90370, 0.90718,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 0.93041, 0.93329}

#declare D_CC_B1 = array[36] {0.11713, 0.14345, 0.17453, 0.19093, 0.19560, 0.19900, 0.20423, 0.21318, 0.22842, 0.25127, 0.28005, 0.30878, 0.32945,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 0.71709, 0.73382}
#declare D_CC_B2 = array[36] {0.12236, 0.16448, 0.22850, 0.28608, 0.32730, 0.36108, 0.38757, 0.39963, 0.39157, 0.36243, 0.31612, 0.26024, 0.20858,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 0.28719, 0.33249}
#declare D_CC_B3 = array[36] {0.05195, 0.05306, 0.05420, 0.05545, 0.05677, 0.05856, 0.06137, 0.06576, 0.07483, 0.09269, 0.12488, 0.17789, 0.24579,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 0.11392, 0.11427}
#declare D_CC_B4 = array[36] {0.17085, 0.23206, 0.36507, 0.50656, 0.56749, 0.58270, 0.58770, 0.59009, 0.59099, 0.58977, 0.58841, 0.58843, 0.58898,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 0.56648, 0.56631}

#declare D_CC_C1 = array[36] {0.13036, 0.17707, 0.25101, 0.30625, 0.32392, 0.32993, 0.33283, 0.33097, 0.32342, 0.31134, 0.29823, 0.28533, 0.26943,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 0.13496, 0.14673}
#declare D_CC_C2 = array[36] {0.09600, 0.11466, 0.13058, 0.13508, 0.13345, 0.13159, 0.13021, 0.12811, 0.12505, 0.12048, 0.11512, 0.10985, 0.10494,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 0.60896, 0.61024}
#declare D_CC_C3 = array[36] {0.04992, 0.04877, 0.04759, 0.04724, 0.04716, 0.04735, 0.04742, 0.04692, 0.04607, 0.04518, 0.04444, 0.04429, 0.04468,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 0.73371, 0.73841}
#declare D_CC_C4 = array[36] {0.14421, 0.19246, 0.27184, 0.33081, 0.35042, 0.35692, 0.36123, 0.36326, 0.36297, 0.36081, 0.35874, 0.35811, 0.35846,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 0.33180, 0.33054}

#declare D_CC_D1 = array[36] {0.05124, 0.05423, 0.05599, 0.05704, 0.05786, 0.05895, 0.06030, 0.06131, 0.06228, 0.06325, 0.06478, 0.06738, 0.07531,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 0.12459, 0.13030}
#declare D_CC_D2 = array[36] {0.09199, 0.11601, 0.14561, 0.16853, 0.17847, 0.17301, 0.15797, 0.13878, 0.11913, 0.10140, 0.08695, 0.07518, 0.06609,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 0.43584, 0.47847}
#declare D_CC_D3 = array[36] {0.05798, 0.05442, 0.05216, 0.05198, 0.05263, 0.05398, 0.05608, 0.05942, 0.06659, 0.08068, 0.10688, 0.15204, 0.22507,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 0.79930, 0.80366}
#declare D_CC_D4 = array[36] {0.10519, 0.13133, 0.16260, 0.18017, 0.18592, 0.18953, 0.19286, 0.19423, 0.19378, 0.19233, 0.19106, 0.19085, 0.19125,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 0.17219, 0.17139}

#declare D_CC_E1 = array[36] {0.14423, 0.19827, 0.29443, 0.37544, 0.40837, 0.42095, 0.42618, 0.42609, 0.41932, 0.40343, 0.37927, 0.34636, 0.31112,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 0.37723, 0.39783}
#declare D_CC_E2 = array[36] {0.06103, 0.06125, 0.06192, 0.06291, 0.06397, 0.06593, 0.06921, 0.07473, 0.08549, 0.10506, 0.13867, 0.19209, 0.27073,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 0.37767, 0.37941}
#declare D_CC_E3 = array[36] {0.14455, 0.19511, 0.28259, 0.34577, 0.36182, 0.35432, 0.33361, 0.30571, 0.27623, 0.24756, 0.21805, 0.18988, 0.16786,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 0.81718, 0.82541}
#declare D_CC_E4 = array[36] {0.06796, 0.07672, 0.08388, 0.08741, 0.08888, 0.09044, 0.09187, 0.09204, 0.09135, 0.09039, 0.08975, 0.08965, 0.08981,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 0.08093, 0.08068}

#declare D_CC_F1 = array[36] {0.13627, 0.17946, 0.24689, 0.29682, 0.32028, 0.33708, 0.35550, 0.38119, 0.41913, 0.46596, 0.51048, 0.54581, 0.56719,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 0.22941, 0.22935}
#declare D_CC_F2 = array[36] {0.06282, 0.06284, 0.06334, 0.06354, 0.06371, 0.06442, 0.06536, 0.06599, 0.06694, 0.06841, 0.07128, 0.07571, 0.08722,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 0.68376, 0.68829}
#declare D_CC_F3 = array[36] {0.10773, 0.14119, 0.19247, 0.23641, 0.26085, 0.28550, 0.31740, 0.35313, 0.39024, 0.42597, 0.44561, 0.44423, 0.42321,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 0.07374, 0.07935}
#declare D_CC_F4 = array[36] {0.03102, 0.03199, 0.03228, 0.03256, 0.03275, 0.03282, 0.03282, 0.03262, 0.03248, 0.03240, 0.03233, 0.03231, 0.03228,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 0.03237, 0.03250}


//================================================================================
// IOR tables:
//
//================================================================================

// wavelength nm                 380      390      400      410      420      430      440      450      460      470      480      490      500      510      520      530      540      550      560      570      580     590     600     610      620      630      640      650      660      670      680      690      700      710      720      730

#declare IOR_15     = array[36] {1.513,   1.512,   1.511,   1.510,   1.509,   1.508,   1.507,   1.506,   1.506,   1.505,   1.504,   1.504,   1.503,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   1.495,   1.494}


//================================================================================
// more (use defined) diffuse/specular reflectance data should go here ...
//
//================================================================================

// wavelength nm                 380      390      400      410      420      430      440      450      460      470      480      490      500      510      520      530      540      550      560      570      580      590      600      610      620      630      640      650      660      670      680      690      700      710      720      730

// todo... 



//================================================================================
// IOR functions
// ATM just water, glasses and minerals are moved to seperate files
//
//================================================================================

// water (20°C)
#declare IOR_Water           = array[36];


#for (I, 0, 35)
  #local W  = 0.38 + I*0.01;
  #local W2 = pow(W,2);      
  
  #declare IOR_Water[I]    = ParamIOR_Water(W2);
#end 


//================================================================================
// dummy arrays for quick use with Spectral_XXX macros
//
//================================================================================

#declare Value_0 = array[36] {0,0,0,0,0,0,0,0,0,0,0,0,0,0,0,0,0,0,0,0,0,0,0,0,0,0,0,0,0,0,0,0,0,0,0,0}
#declare Value_1 = array[36] {1,1,1,1,1,1,1,1,1,1,1,1,1,1,1,1,1,1,1,1,1,1,1,1,1,1,1,1,1,1,1,1,1,1,1,1}


//================================================================================
// spectral data set mixer
// example:
// F1 = 1.0 and F2 = 1.0 gives 50:50 of 100%
// F1 = 0.9 and F2 = 0.1 gives 90:10 of 100%
// F1 = 9   and F2 = 1   gives 90:10 of 100%
//
//================================================================================

#macro D_Average (SpecData1, F1, SpecData2, F2)
  #local F = F1 + F2; 
  
  #if ((F <= 0.0) | (F1 < 0) | (F2 < 0))
    error("D_Average: F1 + F2 has to be > 0.0");
  #end  

  #local FF1 = F1/F;
  #local FF2 = F2/F;

  #local Tmp = array[36];

  #for(I, 0, 35)
    #declare Tmp[I] = SpecData1[I]*FF1 + SpecData2[I]*FF2;
  #end
  
  Tmp
#end


#macro D_RGB (R, G, B)
  #local Tmp = array[36];

  #for(I, 0, 35)
    #declare Tmp[I] = D_CC_C3[I]*R*1.1 + D_CC_B3[I]*G*1.7 + D_CC_A3[I]*B*2.0;
  #end
  
  Tmp
#end


//================================================================================
// basic helper macros for the use with spectral data.
//
//================================================================================

#macro C_Spectral (Diffuse)
  rgb Diffuse[WavelengthIndex]
#end   


#macro C_Spectral_Filter (Diffuse, Filter)
  rgb Diffuse[WavelengthIndex] filter Filter[WavelengthIndex]
#end  


#macro C_Spectral_Transmit (Diffuse, Transmit)
  rgb Diffuse[WavelengthIndex] transmit Transmit[WavelengthIndex]
#end  


#macro IOR_Spectral (IOR)
  ior IOR[WavelengthIndex]
#end


#macro FadeColor_Spectral1 (Color)
  fade_color rgb Color[WavelengthIndex]
#end

#macro FadeColor_Spectral2 (Color)
  fade_color rgb pow(Color[WavelengthIndex],2)
#end

#macro FadeColor_Spectral (Color)
  fade_color rgb pow(Color[WavelengthIndex],3)
#end


//================================================================================

#else  // !SpectralMode

//================================================================================
// PREVIEW MODE!
//
// the following is just for the "preview" mode using precalculated values
//================================================================================

//================================================================================
// GretagMacbeth ColorChecker chart.  
//================================================================================

#declare D_CC_A1 = <0.1724, 0.0840, 0.0574>;
#declare D_CC_A2 = <0.7167, 0.1991, 0.0270>;
#declare D_CC_A3 = <0.0234, 0.0491, 0.2916>;
#declare D_CC_A4 = <0.9165, 0.9155, 0.8706>;

#declare D_CC_B1 = <0.5480, 0.2987, 0.2172>;
#declare D_CC_B2 = <0.0650, 0.1062, 0.3924>;
#declare D_CC_B3 = <0.0653, 0.3017, 0.0644>;
#declare D_CC_B4 = <0.5820, 0.5912, 0.5840>;

#declare D_CC_C1 = <0.1099, 0.1970, 0.3361>;
#declare D_CC_C2 = <0.5417, 0.0884, 0.1204>;
#declare D_CC_C3 = <0.4293, 0.0317, 0.0404>;
#declare D_CC_C4 = <0.3553, 0.3610, 0.3591>;

#declare D_CC_D1 = <0.1040, 0.1504, 0.0523>;
#declare D_CC_D2 = <0.1043, 0.0440, 0.1397>;
#declare D_CC_D3 = <0.8570, 0.5752, 0.0078>;
#declare D_CC_D4 = <0.1876, 0.1924, 0.1917>;

#declare D_CC_E1 = <0.2242, 0.2178, 0.4305>;
#declare D_CC_E2 = <0.3547, 0.5078, 0.0483>;
#declare D_CC_E3 = <0.5030, 0.0887, 0.3055>;
#declare D_CC_E4 = <0.0871, 0.0899, 0.0910>;

#declare D_CC_F1 = <0.1235, 0.5191, 0.4047>;
#declare D_CC_F2 = <0.7804, 0.3540, 0.0216>;
#declare D_CC_F3 = <0.0000, 0.2489, 0.3831>;
#declare D_CC_F4 = <0.0318, 0.0320, 0.0327>;


//================================================================================
// IOR 1.5 at 550nm
//
//================================================================================

#declare IOR_15      = 1.5;


//================================================================================
// more (user defined) diffuse/specular reflectance data should go here ...
//
//================================================================================



//================================================================================
// parametric IOR at 550nm
//
//================================================================================

#local W2 = pow(WavelengthFromIndex(WavelengthIndex)/1000, 2);

#declare IOR_Water    = ParamIOR_Water(W2);


//================================================================================
// dummy values for the use with Spectral_XXX macros
//
//================================================================================

#declare Value_0 = 0;
#declare Value_1 = 1;


//================================================================================
// rgb mixer
//
//================================================================================

#macro D_Average (SpecData1, F1, SpecData2, F2)
  #local F = F1 + F2; 
  
  #if ((F <= 0.0) | (F1 < 0) | (F2 < 0))
    error("D_Average: F1 + F2 has to be > 0.0");
  #end  

  #local FF1 = F1/F;
  #local FF2 = F2/F;

  (SpecData1*FF1 + SpecData2*FF2)
#end


#macro D_RGB (R, G, B)
  (D_CC_C3*R*1.1 + D_CC_B3*G*1.7 + D_CC_A3*B*2.0)
#end


//================================================================================
// basic helper macros for preview - corresponding to those with spectral data.
//
//================================================================================ 

#macro C_Spectral (Diffuse)
  rgb Diffuse
#end


#macro C_Spectral_Filter (Diffuse, Filter)
  rgb Diffuse filter Filter
#end  


#macro C_Spectral_Transmit (Diffuse, Transmit)
  rgb Diffuse transmit Transmit
#end  


#macro IOR_Spectral (IOR)
  ior IOR
#end


#macro FadeColor_Spectral1 (Color) 
  #local C = rgb Color;
  fade_color rgb <C.red, C.green, C.blue>
#end


#macro FadeColor_Spectral2 (Color) 
  #local C = rgb Color;
  fade_color rgb <pow(C.red,2), pow(C.green,2), pow(C.blue,2)>
#end

#macro FadeColor_Spectral (Color) 
  #local C = rgb Color;
  fade_color rgb <pow(C.red,3), pow(C.green,3), pow(C.blue,3)>
#end


//================================================================================ 

#end // !SpectralMode


//================================================================================ 
//
// HIGH LEVEL INTERFACE
// ********************
//
// macros that are the same for spectral and rgb preview rendering
// Use them as they are or just as a reference for creating your own.
//
// Note that I'm just a color guy and not an expert in material properties.
// As such those macros do reflect just my poor ideas and do claim by no means
// any accurate real world behaviour or scientific usefulness.
// ... but any hints on this matter would be highly appreciated ;)
//
//================================================================================  


#macro C_Average (Diffuse1, F1, Diffuse2, F2)
  C_Spectral(D_Average(Diffuse1, F1, Diffuse2, F2))
#end


#macro C_RGB (R, G, B)
  C_Spectral(D_RGB(R, G, B))
#end


#macro P_Spectral (Diffuse)
  pigment {C_Spectral(Diffuse)}
#end  


#macro P_Spectral_Filter (Diffuse, Filter)
  pigment {C_Spectral_Filter(Diffuse, Filter)} 
#end       


#macro P_Spectral_Transmit (Diffuse, Transmit)
  pigment {C_Spectral_Transmit(Diffuse, Transmit)} 
#end       


#macro T_Spectral_Matte (Diffuse)
  texture {
    P_Spectral (Diffuse)
    finish {
      ambient 0  emission 0  diffuse 1
    }
  }  
#end  


#macro T_Spectral_Emitting (Emission, Intensity)
  texture {
    P_Spectral (Emission)
    finish {
      ambient 0  emission Intensity  diffuse 0
    }
  }
#end  


#macro M_Spectral_Matte (Diffuse)
  material {
    T_Spectral_Matte (Diffuse)
  }
#end


#macro M_Spectral_Emitting (Emission, Intensity)
  material {
    T_Spectral_Emitting (Emission, Intensity)
  }
#end  


#macro M_Spectral_Shiny (Diffuse, Reflect, IOR)
  material {
    texture {
      P_Spectral (Diffuse)
      finish {
        ambient 0  emission 0  diffuse 1-Reflect
        reflection {0, Reflect fresnel on} conserve_energy
      }
    }
    interior { IOR_Spectral(IOR) }
  }
#end


#macro M_Spectral_Filter (Diffuse, IOR, FadeDist)
  material {
    texture {
      P_Spectral_Filter (Diffuse, Value_1)
      finish {
        ambient 0  emission 0  diffuse 0
        reflection {0 1 fresnel on} conserve_energy
      }
    }
    interior {
      IOR_Spectral(IOR)
      fade_power 1001
      fade_distance FadeDist
      FadeColor_Spectral (Diffuse)
    }
  }
#end


//================================================================================

#end  // ifndef (spectral_materials_inc)

